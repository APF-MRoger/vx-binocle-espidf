## emulator-console/main/Kconfig.projbuild
```kconfig
menu "Emulator console configuration"

    config CONSOLE_STORE_HISTORY
        bool "Store command history in flash"
        default y
        help
            Linenoise line editing library provides functions to save and load
            command history. If this option is enabled, initializes a FAT filesystem
            and uses it to store command history.

    config CONSOLE_MAX_COMMAND_LINE_LENGTH
        int "Maximum command line length"
        default 1024
        help
            This value marks the maximum length of a single command line. Once it is
            reached, no more characters will be accepted by the console.

    menu "I2C devices configuration"
        config SDA_PIN
            int "SDA GPIO for I2C"
            default 5

        config SCL_PIN
            int "SCL GPIO for I2C"
            default 6

        config PRIMARY_IO_EXPANDER_ADDRESS
            hex "Default hex address for primary IO Expander"
            default 0x20
            help
                Sets the default address value for the primary GPIO expander. 
                0x20 for a PCF8574 with A0->A2 = 0.        
    endmenu

    menu "PWM generators IO"
        config COOLANT_PWM_GEN_GPIO
            int "GPIO for the coolant PWM generator on LEDC Channel 0"
            default 1

        config RPM_PWM_GEN_GPIO
            int "GPIO for the RPM PWM generator on LEDC Channel 1"
            default 2

        config SPEED_PWM_GEN_GPIO
            int "GPIO for the speed PWM generator on LEDC Channel 2"
            default 3
        
    endmenu

    menu "PWM generators parameters"
        config COOLANT_PWM_BASE_FREQ_HZ
            int "Lowest possible frequency for this PWM generator, in Hertz."
            default 100
            help
                On the Coolant channel, the PWM is modulated in duty cycle, not in frequency. 
                This is relevant for duty resolution calculaiton, recommended value is 100Hz.

        config COOLANT_PWM_BASE_DUTY_PCT
            int "Starting duty cycle, in entire percentile."
            default 10

        config RPM_PWM_BASE_FREQ_HZ
            int "Lowest possible frequency for this PWM generator, in Hertz."
            default 3
            help
                For the RPM channel, this is a very low RPM (very far away from idle RPM).
                The 3Hz limit is a functional limit because of the input clock of the LEDC module
                and the limit to 15 bits resolution for hte duty modulation.

        config RPM_PWM_BASE_DUTY_PCT
            int "Starting duty cycle, in entire percentile."
            default 25
        

        config SPEED_PWM_BASE_FREQ_HZ
            int "Lowest possible frequency for this PWM generator, in Hertz."
            default 3
            help
                For the SPEED channel, this is a very low kph value (normally under 1kph or 1mph).
                The 3Hz limit is a functional limit because of the input clock of the LEDC module
                and the limit to 15 bits resolution for hte duty modulation.

        config SPEED_PWM_BASE_DUTY_PCT
            int "Starting duty cycle, in entire percentile."
            default 33
    endmenu

endmenu
```

## interface_board/main/Kconfig.projbuild
```kconfig
menu "Interface board configuration"
    
    menu "I²C configuration"
        config SDA_PIN
            int "SDA GPIO for I2C"
            default 12

        config SCL_PIN
            int "SCL GPIO for I2C"
            default 13
                
        config PRIMARY_ADC_ADDR
            hex "Hex address for primary ADC chip"
            default 0x48
            help
                Sets the default address for the ADC. 
                0x48 for a ADS1115 without address bits set.
        
        config ADC_TO_SMA_POLLING_RATE_MS
            int "Polling interval to add an element to the SMA"
            default 200
            help
                Keep it relative to the SMA size to increase filtering and lag or not.

        config SMA_0_SIZE
            int "Size of SMA filter for ADC 0"
            default 100
            help
                Multiply it by polling rate to get time window. E.g. 200ms at 100 elements -> 20s filtering.
            
        config SMA_1_SIZE
            int "Size of SMA filter for ADC 1"
            default 10
            help
                Multiply it by polling rate to get time window. E.g. 200ms at 100 elements -> 20s filtering.

        config SMA_2_SIZE
            int "Size of SMA filter for ADC 2"
            default 10
            help
                Multiply it by polling rate to get time window. E.g. 200ms at 100 elements -> 20s filtering.

        config SMA_3_SIZE
            int "Size of SMA filter for ADC 3"
            default 10
            help
                Multiply it by polling rate to get time window. E.g. 200ms at 100 elements -> 20s filtering.
    endmenu

    menu "IO Expander configuration"

        config EXP_INT_PIN
            int "Interrupt pin for primary expander"
            default 11
            help
                Interrupt pin for the primary expander. Might be reversed logic!

        config USE_EXPANDER_INTERRUPT
            bool "Whether or not to use the expander interrupt to be more reactive"
            default true
            help
                This might create core panics. Use wisely.

        config INTERRUPT_DEBOUNCE_US
            depends on USE_EXPANDER_INTERRUPT
            int "Debounce time for expander interrupt, in microseconds"
            default 2000

        config EXPANDER_POLLING_RATE_MS
            int "Polling rate of the primary expander in ms"
            default 50
                    

        config PRIMARY_IO_EXPANDER_ADDRESS
            hex "Default hex address for primary IO Expander"
            default 0x20
            help
                Sets the default address value for the primary GPIO expander. 
                0x20 for a PCF8574 with A0->A2 = 0.

    endmenu

    menu "MCPWM configuration"
        config LOOP_LOG_MCPWM
            bool "Read MCPWM values in main loop."
            default true

        config COOLANT_PWM_CAP_GPIO
            int "GPIO for the capture of the coolant PWM"
            default 7

        config RPM_PWM_CAP_GPIO
            int "GPIO for the capture of the RPM pulses"
            default 8

        config SPEED_PWM_CAP_GPIO
            int "GPIO for the capture of the speed PWM"
            default 9 
    endmenu

endmenu
```
